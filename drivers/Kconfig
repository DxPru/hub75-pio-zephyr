## drivers/Kconfig
```kconfig
# Copyright (c) 2024 DxPru
# SPDX-License-Identifier: Apache-2.0

menu "Drivers"
rsource "display/Kconfig"
endmenu
```

## drivers/display/Kconfig
```kconfig
# Copyright (c) 2024 DxPru
# SPDX-License-Identifier: Apache-2.0

menuconfig DISPLAY
    bool "Display drivers"
    help
      This option enables the display driver class

if DISPLAY

config DISPLAY_INIT_PRIOROTY
    int "Display device driver init priority"
    default KERNEL_INIT_PRIORITY_DEVICE
    help
        Display device drivers init priority

module = DISPLAY
module-str = display
source "subsys/logging/Kconfig.template.log_config"

rsource "Kconfig.hub75_pio"

endif # DISPLAY
```

## drivers/display/Kconfig.hub75_pio
```kconfig
# Copyright (c) 2024 DxPru
# SPDX-License-Identifier: Apache-2.0

config DISPLAY_HUB75_PIO
    bool "Hub75 Pio display driver"
    default y
    select PICOSDK_USE_PIO
    select PICOSDK_USE_CLAIM
    depends on RESET
    help
        Hub75 Pio display driver
```
